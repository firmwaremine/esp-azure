## examples/azure_project/main/Kconfig.projbuild
```kconfig
menu "Example Configuration"
    menu "Fan Configuration"
        config FAN_ENABLE_SIGNAL
            int "FAN Enable GPIO Num"
            default 17
            help
                GPIO number for L298N Enable First H-bridge
        config FAN_IN1_SIGNAL
            int "FAN IN1 GPIO Num"
            default 16
            help
                GPIO number for L298N IN1 First H-bridge
        config FAN_IN2_SIGNAL
            int "FAN IN2 GPIO Num"
            default 4
            help
                GPIO number for L298N IN2 First H-bridge
    endmenu
    menu "Azure Configuration"
        config WIFI_SSID
            string "WiFi SSID"
        	default "myssid"
        	help
        		SSID (network name) for the example to connect to.
        
        config WIFI_PASSWORD
            string "WiFi Password"
        	default "myssid"
        	help
        		WiFi password (WPA or WPA2) for the example to use.
        
        		Can be left blank if the network has no security set.
        
        config IOTHUB_CONNECTION_STRING
            string "IOT Hub Device Connection String"
        	default ""
            help
        		String containing Hostname, Device Id & Device Key in the format:
        		HostName=<host_name>;DeviceId=<device_id>;SharedAccessKey=<device_key>
        		You can get this from the Azure IoT CLI or the Azure Portal.
        
        config DEVICE_ID
        	string "device ID"
        	default "device ID"
        	help
        		device ID.
    endmenu
    menu "I2C Configuration"
        config I2C_MASTER_SCL
            int "SCL GPIO Num"
            default 32
            help
                GPIO number for I2C Master clock line.

        config I2C_MASTER_SDA
            int "SDA GPIO Num"
            default 33
            help
                GPIO number for I2C Master data line.

        config I2C_MASTER_PORT_NUM
            int "Port Number"
            default 1
            help
                Port number for I2C Master device.

        config I2C_MASTER_FREQUENCY
            int "Master Frequency"
            default 100000
            help
                I2C Speed of Master device.
    endmenu
endmenu
```
